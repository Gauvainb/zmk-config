#include <dt-bindings/zmk/matrix_transform.h>
#include <dt-bindings/zmk/physical_layouts.h>

/ {
    chosen {
        zmk,kscan = &kscan0;
        zmk,physical-layout = &physical_layout;
        // Remove zmk,matrix-transform if present
    };

    physical_layout: physical_layout {
        compatible = "zmk,physical-layout";
        display-name = "Default Layout";
        
        keys = <
            // Row 0 (Top row - Function keys)
            &key_physical_attrs <100 100 0 0 0 0 0>     // ESC
            &key_physical_attrs <100 100 125 0 0 0 0>   // F1
            &key_physical_attrs <100 100 225 0 0 0 0>   // F2
            &key_physical_attrs <100 100 325 0 0 0 0>   // F3
            &key_physical_attrs <100 100 425 0 0 0 0>   // F4
            &key_physical_attrs <100 100 550 0 0 0 0>   // F5
            &key_physical_attrs <100 100 650 0 0 0 0>   // F6
            &key_physical_attrs <100 100 750 0 0 0 0>   // F7
            &key_physical_attrs <100 100 850 0 0 0 0>   // F8
            &key_physical_attrs <100 100 975 0 0 0 0>   // F9
            &key_physical_attrs <100 100 1075 0 0 0 0>  // F10
            &key_physical_attrs <100 100 1175 0 0 0 0>  // F11
            &key_physical_attrs <100 100 1275 0 0 0 0>  // F12
            &key_physical_attrs <100 100 1400 0 0 0 0>  // Delete
            
            // Row 1 (Number row)
            &key_physical_attrs <100 100 0 125 0 0 0>    // `
            &key_physical_attrs <100 100 100 125 0 0 0>  // 1
            &key_physical_attrs <100 100 200 125 0 0 0>  // 2
            &key_physical_attrs <100 100 300 125 0 0 0>  // 3
            &key_physical_attrs <100 100 400 125 0 0 0>  // 4
            &key_physical_attrs <100 100 500 125 0 0 0>  // 5
            &key_physical_attrs <100 100 600 125 0 0 0>  // 6
            &key_physical_attrs <100 100 700 125 0 0 0>  // 7
            &key_physical_attrs <100 100 800 125 0 0 0>  // 8
            &key_physical_attrs <100 100 900 125 0 0 0>  // 9
            &key_physical_attrs <100 100 1000 125 0 0 0> // 0
            &key_physical_attrs <100 100 1100 125 0 0 0> // -
            &key_physical_attrs <100 100 1200 125 0 0 0> // =
            &key_physical_attrs <200 100 1300 125 0 0 0> // Backspace (2u)
            
            // Row 2 (QWERTY row)
            &key_physical_attrs <150 100 0 225 0 0 0>    // Tab (1.5u)
            &key_physical_attrs <100 100 150 225 0 0 0>  // Q
            &key_physical_attrs <100 100 250 225 0 0 0>  // W
            &key_physical_attrs <100 100 350 225 0 0 0>  // E
            &key_physical_attrs <100 100 450 225 0 0 0>  // R
            &key_physical_attrs <100 100 550 225 0 0 0>  // T
            &key_physical_attrs <100 100 650 225 0 0 0>  // Y
            &key_physical_attrs <100 100 750 225 0 0 0>  // U
            &key_physical_attrs <100 100 850 225 0 0 0>  // I
            &key_physical_attrs <100 100 950 225 0 0 0>  // O
            &key_physical_attrs <100 100 1050 225 0 0 0> // P
            &key_physical_attrs <100 100 1150 225 0 0 0> // [
            &key_physical_attrs <100 100 1250 225 0 0 0> // ]
            &key_physical_attrs <150 100 1350 225 0 0 0> // \ (1.5u)
            
            // Row 3 (ASDF row)
            &key_physical_attrs <175 100 0 325 0 0 0>    // Caps Lock (1.75u)
            &key_physical_attrs <100 100 175 325 0 0 0>  // A
            &key_physical_attrs <100 100 275 325 0 0 0>  // S
            &key_physical_attrs <100 100 375 325 0 0 0>  // D
            &key_physical_attrs <100 100 475 325 0 0 0>  // F
            &key_physical_attrs <100 100 575 325 0 0 0>  // G
            &key_physical_attrs <100 100 675 325 0 0 0>  // H
            &key_physical_attrs <100 100 775 325 0 0 0>  // J
            &key_physical_attrs <100 100 875 325 0 0 0>  // K
            &key_physical_attrs <100 100 975 325 0 0 0>  // L
            &key_physical_attrs <100 100 1075 325 0 0 0> // ;
            &key_physical_attrs <100 100 1175 325 0 0 0> // '
            &key_physical_attrs <225 100 1275 325 0 0 0> // Enter (2.25u)
            
            // Row 4 (ZXCV row)
            &key_physical_attrs <225 100 0 425 0 0 0>    // Left Shift (2.25u)
            &key_physical_attrs <100 100 225 425 0 0 0>  // Z
            &key_physical_attrs <100 100 325 425 0 0 0>  // X
            &key_physical_attrs <100 100 425 425 0 0 0>  // C
            &key_physical_attrs <100 100 525 425 0 0 0>  // V
            &key_physical_attrs <100 100 625 425 0 0 0>  // B
            &key_physical_attrs <100 100 725 425 0 0 0>  // N
            &key_physical_attrs <100 100 825 425 0 0 0>  // M
            &key_physical_attrs <100 100 925 425 0 0 0>  // ,
            &key_physical_attrs <100 100 1025 425 0 0 0> // .
            &key_physical_attrs <100 100 1125 425 0 0 0> // /
            &key_physical_attrs <175 100 1225 425 0 0 0> // Right Shift (1.75u)
            &key_physical_attrs <100 100 1400 425 0 0 0> // Up Arrow
            
            // Row 5 (Bottom row)
            &key_physical_attrs <125 100 0 525 0 0 0>    // Left Ctrl (1.25u)
            &key_physical_attrs <125 100 125 525 0 0 0>  // Left GUI (1.25u)
            &key_physical_attrs <125 100 250 525 0 0 0>  // Left Alt (1.25u)
            &key_physical_attrs <625 100 375 525 0 0 0>  // Space (6.25u)
            &key_physical_attrs <125 100 1000 525 0 0 0> // Right Alt (1.25u)
            &key_physical_attrs <125 100 1125 525 0 0 0> // Right GUI (1.25u)
            &key_physical_attrs <125 100 1250 525 0 0 0> // Menu (1.25u)
            &key_physical_attrs <100 100 1375 525 0 0 0> // Left Arrow
            &key_physical_attrs <100 100 1400 525 0 0 0> // Down Arrow
            &key_physical_attrs <100 100 1425 525 0 0 0> // Right Arrow
        >;
    };

    kscan0: kscan {
        compatible = "zmk,kscan-gpio-matrix";
        wakeup-source;
        
        // Your existing kscan configuration...
    };
};