/*
 * Copyright (c) 2023 The ZMK Contributors
 *
 * SPDX-License-Identifier: MIT
 */

/ {
    key_physical_attrs: key_physical_attrs {
        compatible = "zmk,physical-layout-position";
        
        // Cette macro définit les attributs par défaut pour les touches
        // Arguments: width, height, x, y, rotation, rx, ry
        #size-cells = <7>;
        #address-cells = <0>;
    };
};